## main/Kconfig.projbuild
```kconfig
#
# The following resource taught me how to use KConfig
# to create `menuconfig` options:
# https://medium.com/@bhautik.markeye/esp-idf-configuration-how-to-add-custom-configuration-in-project-config-728f81b8d0d8.
#

menu "UCSC Thread-Ascon OpenThread Sender"

    config OPENTHREAD_AUTO_START
        bool 'Enable the automatic start mode.'
        default False
        help
            If enabled, the Openthread Device will create or connect to thread network with pre-configured
            network parameters automatically. Otherwise, user need to configure Thread via CLI command manually.

    config TX_POWER
        int 'Set the 802.15.4 TX power used by OpenThread'
        range -127 128
        default 20
        help
            Set the 802.15.4 transmission power (in dBm) for OpenThread.
            The recommended TX power values are 20 dBm, 9 dBm, 0 dBm, and -25 dBm.


endmenu
```
